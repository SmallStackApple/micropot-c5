## main/Kconfig.projbuild
```kconfig
menu "MicroPot-C5 honeypot"

    menu "Network"
        config MICROPOT_WIFI_SSID
            string "WiFi SSID (isolated lab network)"
            default "micropot-lab"

        config MICROPOT_WIFI_PASSWORD
            string "WiFi password"
            default "micropot123"

        config MICROPOT_USE_STATIC_IP
            bool "Use a static IPv4 address"
            default n

        config MICROPOT_STATIC_IP
            string "Static IPv4 address"
            depends on MICROPOT_USE_STATIC_IP
            default "192.168.1.100"

        config MICROPOT_STATIC_NETMASK
            string "Static netmask"
            depends on MICROPOT_USE_STATIC_IP
            default "255.255.255.0"

        config MICROPOT_STATIC_GW
            string "Static gateway"
            depends on MICROPOT_USE_STATIC_IP
            default "192.168.1.1"

        config MICROPOT_LINK_PROBES
            bool "Link-liveness probes (DEBUG: emits periodic ARP/ping)"
            default n
            help
                Every 15s: ARP-request the gateway, ICMP-ping it once, and
                send a gratuitous ARP; results appear in the stats line as
                gwarp/gwping. A real Linux host never emits such periodic
                traffic, so this MUST stay off in any build exposed to
                scanners — it exists purely to diagnose link-layer stalls.
    endmenu

    menu "Honeypot services"
        config MICROPOT_TELNET_PORT
            int "Telnet port"
            range 1 65535
            default 23

        config MICROPOT_HTTP_PORT
            int "HTTP port"
            range 1 65535
            default 80

        config MICROPOT_SSH_PORT
            int "SSH port (banner-level honeypot)"
            range 1 65535
            default 22

        config MICROPOT_FTP_PORT
            int "FTP port (vsftpd-style honeypot)"
            range 1 65535
            default 21

        config MICROPOT_MAX_SESSIONS
            int "Max concurrent honeypot sessions (global budget)"
            range 2 32
            default 8
            help
                All TCP listeners share this budget of concurrent connection
                tasks. Excess connections are accepted and closed at once so
                a flood cannot exhaust heap and crash the honeypot.
    endmenu

    menu "Device persona"
        choice MICROPOT_ACTIVE_PERSONA
            prompt "Active persona"
            default MICROPOT_PERSONA_CAMERA
            help
                Phase 1 exposes exactly one persona on the single device IP.
                Phase 2 will select personas per virtual IP at runtime.
            config MICROPOT_PERSONA_CAMERA
                bool "HIKVISION-style IP camera"
            config MICROPOT_PERSONA_ROUTER
                bool "TP-LINK-style home router"
            config MICROPOT_PERSONA_PRINTER
                bool "HP LaserJet-style network printer"
            config MICROPOT_PERSONA_LINUX419
                bool "Generic Linux 4.19 server (OpenSSH/Apache/root shell)"
        endchoice
    endmenu

    menu "Virtual devices (IP aliases)"

        config MICROPOT_VDEV1_IP
            string "vdev1 alias IPv4 (0.0.0.0 = disabled)"
            default "0.0.0.0"
        config MICROPOT_VDEV1_PERSONA
            string "vdev1 persona id (needs a wire profile)"
            default ""

        config MICROPOT_VDEV2_IP
            string "vdev2 alias IPv4"
            default "0.0.0.0"
        config MICROPOT_VDEV2_PERSONA
            string "vdev2 persona id"
            default ""

        config MICROPOT_VDEV3_IP
            string "vdev3 alias IPv4"
            default "0.0.0.0"
        config MICROPOT_VDEV3_PERSONA
            string "vdev3 persona id"
            default ""

        config MICROPOT_VDEV4_IP
            string "vdev4 alias IPv4"
            default "0.0.0.0"
        config MICROPOT_VDEV4_PERSONA
            string "vdev4 persona id"
            default ""

        config MICROPOT_VDEV5_IP
            string "vdev5 alias IPv4"
            default "0.0.0.0"
        config MICROPOT_VDEV5_PERSONA
            string "vdev5 persona id"
            default ""

        config MICROPOT_VDEV6_IP
            string "vdev6 alias IPv4"
            default "0.0.0.0"
        config MICROPOT_VDEV6_PERSONA
            string "vdev6 persona id"
            default ""

        config MICROPOT_VDEV7_IP
            string "vdev7 alias IPv4"
            default "0.0.0.0"
        config MICROPOT_VDEV7_PERSONA
            string "vdev7 persona id"
            default ""
    endmenu

    menu "Structured logging"
        choice MICROPOT_LOG_PROTO
            prompt "Log transport"
            default MICROPOT_LOG_PROTO_UDP
            config MICROPOT_LOG_PROTO_UDP
                bool "UDP (best effort, low overhead)"
            config MICROPOT_LOG_PROTO_TCP
                bool "TCP (connection oriented, auto reconnect)"
        endchoice

        config MICROPOT_LOG_HOST
            string "Collector IPv4 address"
            default "192.168.1.10"

        config MICROPOT_LOG_PORT
            int "Collector UDP/TCP port"
            range 1 65535
            default 9999

        config MICROPOT_LOG_CONSOLE
            bool "Echo every event to the serial console"
            default n
            help
                Print each JSON event to the console in addition to shipping
                it to the collector. Handy while developing, but the console
                UART write is blocking: a flood of events keeps the logger
                task busy and starves the idle task (task watchdog). Leave
                this off for any build that must survive load testing; the
                collector still receives every event.
    endmenu

endmenu
```
